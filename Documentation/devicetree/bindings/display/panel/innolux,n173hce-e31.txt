## Documentation/devicetree/bindings/display/panel/innolux,n173hce-e31.txt
```
InnoLux 17.3" FHD TFT LCD panel

Required properties:
- compatible: should be "innolux,n173hce-e31"

This binding is compatible with the simple-panel binding, which is specified
in simple-panel.txt in this directory.
```
